/*
 * ch32v203_st7735s.c
 *
 *  Created on: Sep 15, 2025
 *      Author: dragomir
 */
#include "ch32v20x.h"
#include "ch32v203_core.h"
#include "ch32v203_gpio.h"
#include "ch32v203_spi.h"
#include "ch32v203_st7735s.h"

uint32_t fill_color;
uint32_t text_bg_color;
uint32_t text_fg_color;

const uint8_t st7735s_8x8_font[1024] = {
	0x00, 0x00, 0x00, 0x00, 0x00, 0x00, 0x00, 0x00, 0x00, 0x00, 0x00, 0x00,
	0x00, 0x00, 0x00, 0x00, 0x00, 0x00, 0x00, 0x00, 0x00, 0x00, 0x00, 0x00,
	0x00, 0x00, 0x00, 0x00, 0x00, 0x00, 0x00, 0x00, 0x00, 0x00, 0x00, 0x00,
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	0x00, 0x00, 0x00, 0x00
};

//Copied from: https://github.com/Dungyichao/STM32F4-LCD_ST7735s/blob/master/ST7735/st7735.c
const uint8_t gmctrp1_tab[16] = {0x02, 0x1C, 0x07, 0x12, 0x37, 0x32, 0x29, 0x2D, 0x29, 0x25, 0x2B, 0x39, 0x00, 0x01, 0x03, 0x10};
const uint8_t gmctrn1_tab[16] = {0x03, 0x1D, 0x07, 0x06, 0x2E, 0x2C, 0x29, 0x2D, 0x2E, 0x2E, 0x37, 0x3F, 0x00, 0x00, 0x02, 0x10};
//Copied from:https://github.com/kitten-yyds/STM32-ST7725S/blob/main/lib/ST7735S.c
//const uint8_t gmctrp1_tab[16] = {0x12, 0x1C, 0x10, 0x18, 0x33, 0x2C, 0x25, 0x28, 0x28, 0x27, 0x2F, 0x3C, 0x00, 0x03, 0x03, 0x10};
//const uint8_t gmctrn1_tab[16] = {0x12, 0x1C, 0x10, 0x18, 0x2D, 0x28, 0x23, 0x28, 0x28, 0x26, 0x2F, 0x3B, 0x00, 0x03, 0x03, 0x10};

void st7735s_init(void)
{
	gpio_clear_pin(ST7735S_PORT_RST, ST7735S_PIN_RST);
	core_delay_us(10);
	gpio_set_pin(ST7735S_PORT_RST, ST7735S_PIN_RST);
	gpio_set_pin(ST7735S_PORT_CS, ST7735S_PIN_CS);
	core_delay_ms(120);
	spi_init(ST7735S_SPI_MODULE, SPI_8_BIT | ST7735S_SPI_CLK_DIV | SPI_MODE_0);

	st7735s_send_command(ST7735S_COM_SLEEP_OUT);
	core_delay_ms(120);
	st7735s_send_command(ST7735S_COM_FRMCTR1);
	st7735s_send_data(ST7735S_DEF_RTNA);
	st7735s_send_data(ST7735S_DEF_FPA);
	st7735s_send_data(ST7735S_DEF_BPA);
	st7735s_send_command(ST7735S_COM_FRMCTR2);
	st7735s_send_data(ST7735S_DEF_RTNB);
	st7735s_send_data(ST7735S_DEF_FPB);
	st7735s_send_data(ST7735S_DEF_BPB);
	st7735s_send_command(ST7735S_COM_FRMCTR3);
	st7735s_send_data(ST7735S_DEF_RTNC);
	st7735s_send_data(ST7735S_DEF_FPC);
	st7735s_send_data(ST7735S_DEF_BPC);
	st7735s_send_data(ST7735S_DEF_RTND);
	st7735s_send_data(ST7735S_DEF_FPD);
	st7735s_send_data(ST7735S_DEF_BPD);
	st7735s_send_command(ST7735S_COM_INVCTR);
	st7735s_send_data(ST7735S_DEF_INV_MODE);
	st7735s_send_command(ST7735S_COM_PWRCTR1);
	st7735s_send_data(ST7735S_DEF_AVDD_VRHP);
	st7735s_send_data(ST7735S_DEF_VRHN);
	st7735s_send_data(ST7735S_DEF_MODE);
	st7735s_send_command(ST7735S_COM_PWRCTR2);
	st7735s_send_data(ST7735S_DEF_VGH_VGL);
	st7735s_send_command(ST7735S_COM_PWRCTR3);
	st7735s_send_data(ST7735S_DEF_SAPA_APA);
	st7735s_send_data(ST7735S_DEF_DCA);
	st7735s_send_command(ST7735S_COM_PWRCTR4);
	st7735s_send_data(ST7735S_DEF_SAPB_APB);
	st7735s_send_data(ST7735S_DEF_DCB);
	st7735s_send_command(ST7735S_COM_PWRCTR5);
	st7735s_send_data(ST7735S_DEF_SAPC_APC);
	st7735s_send_data(ST7735S_DEF_DCC);
	st7735s_send_command(ST7735S_COM_VMCTR1);
	st7735s_send_data(ST7735S_DEF_VCOMS);
	st7735s_send_command(ST7735S_COM_INVOFF);
	st7735s_send_command(ST7735S_COM_MADCTL);
	st7735s_send_data(ST7735S_DEF_MLAYOUT);
	st7735s_send_command(ST7735S_COM_COLMOD);
	st7735s_send_data(0x06);

	st7735s_send_command(ST7735S_COM_GMCTRP1);
	for(uint8_t d = 0; d < 16; ++d)
	{
		st7735s_send_data(gmctrp1_tab[d]);
	}
	st7735s_send_command(ST7735S_COM_GMCTRN1);
	for(uint8_t d = 0; d < 16; ++d)
	{
		st7735s_send_data(gmctrn1_tab[d]);
	}

	fill_color = 0x00FF00FF;
	st7735s_fill_display();

	st7735s_send_command(ST7735S_COM_NORON);
	st7735s_send_command(ST7735S_COM_DISPON);
}

void st7735s_send_command(uint8_t command)
{
	gpio_clear_pin(ST7735S_PORT_DC, ST7735S_PIN_DC);
	gpio_clear_pin(ST7735S_PORT_CS, ST7735S_PIN_CS);
	(void)spi_transfer(ST7735S_SPI_MODULE, command);
	gpio_set_pin(ST7735S_PORT_CS, ST7735S_PIN_CS);
}

void st7735s_send_data(uint8_t command)
{
	gpio_set_pin(ST7735S_PORT_DC, ST7735S_PIN_DC);
	gpio_clear_pin(ST7735S_PORT_CS, ST7735S_PIN_CS);
	(void)spi_transfer(ST7735S_SPI_MODULE, command);
	gpio_set_pin(ST7735S_PORT_CS, ST7735S_PIN_CS);
}

void st7735s_set_pixel(uint8_t row, uint8_t col, uint32_t color)
{
	uint8_t* pix_color = (uint8_t*)(&color);

	st7735s_send_command(ST7735S_COM_CASET);
	st7735s_send_data(0x00);
	st7735s_send_data(col);
	st7735s_send_data(0x00);
	st7735s_send_data(col);
	st7735s_send_command(ST7735S_COM_RASET);
	st7735s_send_data(0x00);
	st7735s_send_data(row);
	st7735s_send_data(0x00);
	st7735s_send_data(row);

	st7735s_send_command(ST7735S_COM_RAMWR);
	st7735s_send_data(pix_color[2]);
	st7735s_send_data(pix_color[1]);
	st7735s_send_data(pix_color[0]);
}

uint8_t st7735s_draw_text(uint8_t row, uint8_t col, const char* str)
{
	uint8_t current_char;
	uint16_t font_idx;
	uint8_t font_byte;
	uint8_t num_printed = 0;
	uint8_t* bg_color = (uint8_t*)(&text_bg_color);
	uint8_t* fg_color = (uint8_t*)(&text_fg_color);

	while((col < (ST7735S_NUM_COLUMNS - 8)) && str[num_printed])
	{
		// get char
		current_char = str[num_printed];
		++num_printed;
		if(current_char == '\n')
			continue;
		font_idx = current_char << 3;

		// Set row and column range
		st7735s_send_command(ST7735S_COM_CASET);
		st7735s_send_data(0x00);
		st7735s_send_data(col);
		st7735s_send_data(0x00);
		st7735s_send_data(col + 7);
		st7735s_send_command(ST7735S_COM_RASET);
		st7735s_send_data(0x00);
		st7735s_send_data(row);
		st7735s_send_data(0x00);
		st7735s_send_data(row + 7);

		st7735s_send_command(ST7735S_COM_RAMWR);
		for(uint8_t d = 0; d < 8; ++d)
		{
			// get font byte
			font_byte = st7735s_8x8_font[font_idx++];

			// expand and send byte
			for(uint8_t i = 0; i < 8; ++i)
			{
				if(font_byte & 0x80)
				{
					st7735s_send_data(fg_color[2]);
					st7735s_send_data(fg_color[1]);
					st7735s_send_data(fg_color[0]);
				}
				else
				{
					st7735s_send_data(bg_color[2]);
					st7735s_send_data(bg_color[1]);
					st7735s_send_data(bg_color[0]);
				}
				font_byte = font_byte << 1;
			}
		}

		col += 8;
	}
	return num_printed;
}

void st7735s_fill_display(void)
{
	uint8_t* fill_bgr = (uint8_t*)(&fill_color);

	st7735s_send_command(ST7735S_COM_CASET);
	st7735s_send_data(0x00);
	st7735s_send_data(ST7735S_DA_COL_START);
	st7735s_send_data(0x00);
	st7735s_send_data(ST7735S_DA_COL_END);
	st7735s_send_command(ST7735S_COM_RASET);
	st7735s_send_data(0x00);
	st7735s_send_data(ST7735S_DA_ROW_START);
	st7735s_send_data(0x00);
	st7735s_send_data(ST7735S_DA_ROW_END);

	st7735s_send_command(ST7735S_COM_RAMWR);
	for(uint16_t d = 0; d < ST7735S_NUM_PIXELS; ++d)
	{
		st7735s_send_data(fill_bgr[2]);
		st7735s_send_data(fill_bgr[1]);
		st7735s_send_data(fill_bgr[0]);
	}
}

void st7735s_fill_rectangle(uint8_t start_row, uint8_t start_col, uint8_t end_row, uint8_t end_col)
{
	uint16_t num_pixels = (1 + end_row - start_row) * (1 + end_col - start_col);
	uint8_t* fill_bgr = (uint8_t*)(&fill_color);

	st7735s_send_command(ST7735S_COM_CASET);
	st7735s_send_data(0x00);
	st7735s_send_data(start_col);
	st7735s_send_data(0x00);
	st7735s_send_data(end_col);
	st7735s_send_command(ST7735S_COM_RASET);
	st7735s_send_data(0x00);
	st7735s_send_data(start_row);
	st7735s_send_data(0x00);
	st7735s_send_data(end_row);

	st7735s_send_command(ST7735S_COM_RAMWR);
	for(uint16_t d = 0; d < num_pixels; ++d)
	{
		st7735s_send_data(fill_bgr[2]);
		st7735s_send_data(fill_bgr[1]);
		st7735s_send_data(fill_bgr[0]);
	}
}
