#include "CH547.H"
#include "CH547_GPIO.h"
#include "CH547_RCC.h"
#include "CH547_HX8346.h"

UINT16 hx8346_fill_color;
UINT16 hx8346_text_bg_color;
UINT16 hx8346_text_fg_color;

UINT8 code hx8346_gamma_tab[12] = {0x22, 0x22, 0x20, 0x35, 0x00, 0x77, 0x24, 0x75, 0x12, 0x28, 0x24, 0x44};

UINT8 code hx8346_8x8_font[1024] = {
	0x00, 0x00, 0x00, 0x00, 0x00, 0x00, 0x00, 0x00, 0x00, 0x00, 0x00, 0x00,
	0x00, 0x00, 0x00, 0x00, 0x00, 0x00, 0x00, 0x00, 0x00, 0x00, 0x00, 0x00,
	0x00, 0x00, 0x00, 0x00, 0x00, 0x00, 0x00, 0x00, 0x00, 0x00, 0x00, 0x00,
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	0x00, 0x00, 0x00, 0x00
};

void hx8346_init(void)
{
	UINT8 idx;
	
	gpio_set_pin(HX8346_PORT_CS, HX8346_PIN_CS);
	gpio_set_pin(HX8346_PORT_RS, HX8346_PIN_RS);
	gpio_set_pin(HX8346_PORT_WR, HX8346_PIN_WR);
	gpio_set_pin(HX8346_PORT_RD, HX8346_PIN_RD);
	gpio_clear_pin(HX8346_PORT_RS, HX8346_PIN_RST);
	rcc_delay_us(10);
	gpio_set_pin(HX8346_PORT_RS, HX8346_PIN_RST);
	rcc_delay_ms(120);	//120ms needed before STB out command
	
	gpio_set_mode(GPIO_MODE_PP, HX8346_PORT_DB_L, GPIO_PIN_7 | GPIO_PIN_6 | GPIO_PIN_5 | GPIO_PIN_4 | GPIO_PIN_3 | GPIO_PIN_2 | GPIO_PIN_1 | GPIO_PIN_0);
	gpio_set_mode(GPIO_MODE_PP, HX8346_PORT_DB_H, GPIO_PIN_7 | GPIO_PIN_6 | GPIO_PIN_5 | GPIO_PIN_4 | GPIO_PIN_3 | GPIO_PIN_2 | GPIO_PIN_1 | GPIO_PIN_0);
	gpio_write_port(HX8346_PORT_DB_H, 0x00);
	
	for(idx = 0; idx < 12; ++idx)
	{
		hx8346_write_reg(HX8346_REG_R1_CONTROL_1 + idx, hx8346_gamma_tab[idx]);
	}
	hx8346_write_reg(HX8346_REG_COL_ADDR_START_H, (UINT8)(HX8346_DA_COL_START >> 8));
	hx8346_write_reg(HX8346_REG_COL_ADDR_START_L, (UINT8)HX8346_DA_COL_START);
	hx8346_write_reg(HX8346_REG_COL_ADDR_END_H, (UINT8)(HX8346_DA_COL_END >> 8));
	hx8346_write_reg(HX8346_REG_COL_ADDR_END_L, (UINT8)HX8346_DA_COL_END);
	hx8346_write_reg(HX8346_REG_ROW_ADDR_START_H, (UINT8)(HX8346_DA_ROW_START >> 8));
	hx8346_write_reg(HX8346_REG_ROW_ADDR_START_L, (UINT8)HX8346_DA_ROW_START);
	hx8346_write_reg(HX8346_REG_ROW_ADDR_END_H, (UINT8)(HX8346_DA_ROW_END >> 8));
	hx8346_write_reg(HX8346_REG_ROW_ADDR_END_L, (UINT8)HX8346_DA_ROW_END);
	hx8346_write_reg(HX8346_REG_DISPLAY_MODE_CTRL, HX8346_DISPLAY_MODE_CTRL_INVON | HX8346_DISPLAY_MODE_CTRL_NORON);
	hx8346_write_reg(HX8346_REG_MEMORY_ACCESS_CTRL, HX8346_MEMORY_ACCESS_CTRL_MY | HX8346_MEMORY_ACCESS_CTRL_MV | HX8346_MEMORY_ACCESS_CTRL_BGR);
	hx8346_write_reg(HX8346_REG_CYCLE_CTRL_N_DC, 0x95);
	hx8346_write_reg(HX8346_REG_CYCLE_CTRL_P_DC, 0x95);
	hx8346_write_reg(HX8346_REG_CYCLE_CTRL_I_DC, 0xFF);
	hx8346_write_reg(HX8346_REG_DISPLAY_CONTROL_2, 0x02);
	hx8346_write_reg(HX8346_REG_DISPLAY_CONTROL_3, 0x02);
	hx8346_write_reg(HX8346_REG_DISPLAY_CONTROL_4, 0x02);
	hx8346_write_reg(HX8346_REG_DISPLAY_CONTROL_5, 0x02);
	hx8346_write_reg(HX8346_REG_DISPLAY_CONTROL_6, 0x02);
	hx8346_write_reg(HX8346_REG_DISPLAY_CONTROL_7, 0x02);
	hx8346_write_reg(HX8346_REG_CYCLE_CONTROL_1, 0x01);
	hx8346_write_reg(HX8346_REG_CYCLE_CONTROL_2, 0x01);
	hx8346_write_reg(HX8346_REG_CYCLE_CONTROL_3, 0xF0);
	hx8346_write_reg(HX8346_REG_CYCLE_CONTROL_4, 0x00);
	hx8346_write_reg(HX8346_REG_OSC_CONTROL_1, (0x20 << 1) | HX8346_OSC_CONTROL_1_OSC_EN);
	hx8346_write_reg(HX8346_REG_POWER_CONTROL_6, 0x00);
	hx8346_write_reg(HX8346_REG_POWER_CONTROL_3, 0x07);
	hx8346_write_reg(HX8346_REG_POWER_CONTROL_4, 0x00);
	hx8346_write_reg(HX8346_REG_POWER_CONTROL_5, 0x03);
	hx8346_write_reg(HX8346_REG_VCOM_CONTROL_2, 0x30);
	hx8346_write_reg(HX8346_REG_VCOM_CONTROL_3, 0x0E);
	hx8346_write_reg(HX8346_REG_POWER_CONTROL_2, 0x04);
	hx8346_write_reg(HX8346_REG_POWER_CONTROL_1, 0x18);	//PON, DK
	hx8346_write_reg(HX8346_REG_POWER_CONTROL_1, 0x10);	//PON
	//TODO: wait 40 ms for step-up circuit to stabilize. But VCOMG defaults to 1 anyway?
	//TODO: wait 100 ms before setting SAPS1. But SAPS1 defaults to 0x08?
	hx8346_write_reg(HX8346_REG_VCOM_CONTROL_1, 0x80);	//VCOMG
	hx8346_write_reg(HX8346_REG_DISPLAY_CONTROL_9, 0x08);	//SAPS1
	hx8346_write_reg(HX8346_REG_DISPLAY_CONTROL_1, HX8346_DISPLAY_CONTROL_1_D_ION);
	rcc_delay_ms(15);
	hx8346_write_reg(HX8346_REG_DISPLAY_CONTROL_1, HX8346_DISPLAY_CONTROL_1_GON | HX8346_DISPLAY_CONTROL_1_D_ION);
	hx8346_write_reg(HX8346_REG_DISPLAY_CONTROL_1, HX8346_DISPLAY_CONTROL_1_GON | HX8346_DISPLAY_CONTROL_1_D_ON);
	rcc_delay_ms(15);
	hx8346_write_reg(HX8346_REG_DISPLAY_CONTROL_1, HX8346_DISPLAY_CONTROL_1_GON | HX8346_DISPLAY_CONTROL_1_DTE | HX8346_DISPLAY_CONTROL_1_D_ON);
	
	hx8346_fill_color = 0xF81F;
	hx8346_fill_display();
}

void hx8346_write_reg(UINT8 addr, UINT8 val)
{
	hx8346_cs_assert();
	gpio_clear_pin(HX8346_PORT_RS, HX8346_PIN_RS);
	gpio_write_port(HX8346_PORT_DB_L, addr);
	gpio_clear_pin(HX8346_PORT_WR, HX8346_PIN_WR);
	gpio_set_pin(HX8346_PORT_WR, HX8346_PIN_WR);
	gpio_set_pin(HX8346_PORT_RS, HX8346_PIN_RS);
	gpio_write_port(HX8346_PORT_DB_L, val);
	gpio_clear_pin(HX8346_PORT_WR, HX8346_PIN_WR);
	gpio_set_pin(HX8346_PORT_WR, HX8346_PIN_WR);
	hx8346_cs_release();
}

UINT8 hx8346_read_reg(addr)
{
	UINT8 val;
	
	hx8346_cs_assert();
	gpio_clear_pin(HX8346_PORT_RS, HX8346_PIN_RS);
	gpio_write_port(HX8346_PORT_DB_L, addr);
	gpio_clear_pin(HX8346_PORT_WR, HX8346_PIN_WR);
	gpio_set_pin(HX8346_PORT_WR, HX8346_PIN_WR);
	gpio_set_mode(GPIO_MODE_INPUT, HX8346_PORT_DB_L, GPIO_PIN_7 | GPIO_PIN_6 | GPIO_PIN_5 | GPIO_PIN_4 | GPIO_PIN_3 | GPIO_PIN_2 | GPIO_PIN_1 | GPIO_PIN_0);
	gpio_set_mode(GPIO_MODE_INPUT, HX8346_PORT_DB_H, GPIO_PIN_7 | GPIO_PIN_6 | GPIO_PIN_5 | GPIO_PIN_4 | GPIO_PIN_3 | GPIO_PIN_2 | GPIO_PIN_1 | GPIO_PIN_0);
	gpio_set_pin(HX8346_PORT_RS, HX8346_PIN_RS);
	gpio_clear_pin(HX8346_PORT_RD, HX8346_PIN_RD);
	val = gpio_read_port(HX8346_PORT_DB_L);
	gpio_set_pin(HX8346_PORT_RD, HX8346_PIN_RD);
	hx8346_cs_release();
	gpio_set_mode(GPIO_MODE_PP, HX8346_PORT_DB_L, GPIO_PIN_7 | GPIO_PIN_6 | GPIO_PIN_5 | GPIO_PIN_4 | GPIO_PIN_3 | GPIO_PIN_2 | GPIO_PIN_1 | GPIO_PIN_0);
	gpio_set_mode(GPIO_MODE_PP, HX8346_PORT_DB_H, GPIO_PIN_7 | GPIO_PIN_6 | GPIO_PIN_5 | GPIO_PIN_4 | GPIO_PIN_3 | GPIO_PIN_2 | GPIO_PIN_1 | GPIO_PIN_0);
	return val;
}

//HINT: Use this function to set the GRAM window before writing data.
void hx8346_set_gram_window(UINT16 row, UINT16 col, UINT16 width, UINT16 height)
{
	hx8346_write_reg(HX8346_REG_COL_ADDR_START_H, (UINT8)(col >> 8));
	hx8346_write_reg(HX8346_REG_COL_ADDR_START_L, (UINT8)col);
	hx8346_write_reg(HX8346_REG_ROW_ADDR_START_H, (UINT8)(row >> 8));
	hx8346_write_reg(HX8346_REG_ROW_ADDR_START_L, (UINT8)row);
	row += height - 1;
	col += width - 1;
	hx8346_write_reg(HX8346_REG_COL_ADDR_END_H, (UINT8)(col >> 8));
	hx8346_write_reg(HX8346_REG_COL_ADDR_END_L, (UINT8)col);
	hx8346_write_reg(HX8346_REG_ROW_ADDR_END_H, (UINT8)(row >> 8));
	hx8346_write_reg(HX8346_REG_ROW_ADDR_END_L, (UINT8)row);
	hx8346_cs_assert();
	gpio_clear_pin(HX8346_PORT_RS, HX8346_PIN_RS);
	gpio_write_port(HX8346_PORT_DB_L, HX8346_REG_SRAM_WRITE_CONTROL);
	gpio_clear_pin(HX8346_PORT_WR, HX8346_PIN_WR);
	gpio_set_pin(HX8346_PORT_WR, HX8346_PIN_WR);
	gpio_set_pin(HX8346_PORT_RS, HX8346_PIN_RS);
	hx8346_cs_release();
}

void hx8346_write_data(UINT16* src, UINT16 num_words)
{
	UINT16 pixel;
	
	hx8346_cs_assert();
	while(num_words--)
	{
		pixel = *src++;
		gpio_write_port(HX8346_PORT_DB_H, (UINT8)(pixel >> 8));
		gpio_write_port(HX8346_PORT_DB_L, (UINT8)pixel);
		gpio_clear_pin(HX8346_PORT_WR, HX8346_PIN_WR);
		gpio_set_pin(HX8346_PORT_WR, HX8346_PIN_WR);
	}
	hx8346_cs_release();
}

void hx8346_write_data_single(UINT16 val)
{
	hx8346_cs_assert();
	gpio_write_port(HX8346_PORT_DB_H, (UINT8)(val >> 8));
	gpio_write_port(HX8346_PORT_DB_L, (UINT8)val);
	gpio_clear_pin(HX8346_PORT_WR, HX8346_PIN_WR);
	gpio_set_pin(HX8346_PORT_WR, HX8346_PIN_WR);
	hx8346_cs_release();
}

void hx8346_set_pixel(UINT16 row, UINT16 col, UINT16 color)
{
	hx8346_write_reg(HX8346_REG_COL_ADDR_START_H, (UINT8)(col >> 8));
	hx8346_write_reg(HX8346_REG_COL_ADDR_START_L, (UINT8)col);
	hx8346_write_reg(HX8346_REG_COL_ADDR_END_H, (UINT8)(col >> 8));
	hx8346_write_reg(HX8346_REG_COL_ADDR_END_L, (UINT8)col);
	hx8346_write_reg(HX8346_REG_ROW_ADDR_START_H, (UINT8)(row >> 8));
	hx8346_write_reg(HX8346_REG_ROW_ADDR_START_L, (UINT8)row);
	hx8346_write_reg(HX8346_REG_ROW_ADDR_END_H, (UINT8)(row >> 8));
	hx8346_write_reg(HX8346_REG_ROW_ADDR_END_L, (UINT8)row);
	hx8346_cs_assert();
	gpio_clear_pin(HX8346_PORT_RS, HX8346_PIN_RS);
	gpio_write_port(HX8346_PORT_DB_L, HX8346_REG_SRAM_WRITE_CONTROL);
	gpio_clear_pin(HX8346_PORT_WR, HX8346_PIN_WR);
	gpio_set_pin(HX8346_PORT_WR, HX8346_PIN_WR);
	gpio_set_pin(HX8346_PORT_RS, HX8346_PIN_RS);
	gpio_write_port(HX8346_PORT_DB_H, (UINT8)(color >> 8));
	gpio_write_port(HX8346_PORT_DB_L, (UINT8)color);
	gpio_clear_pin(HX8346_PORT_WR, HX8346_PIN_WR);
	gpio_set_pin(HX8346_PORT_WR, HX8346_PIN_WR);
	hx8346_cs_release();
}

void hx8346_fill_rectangle(UINT16 row, UINT16 col, UINT16 width, UINT16 height)
{
	UINT32 num_pixels;
	
	num_pixels = (UINT32)width * (UINT32)height;
	hx8346_set_gram_window(row, col, width, height);
	hx8346_cs_assert();
	while(num_pixels--)
	{
		gpio_write_port(HX8346_PORT_DB_H, (UINT8)(hx8346_fill_color >> 8));
		gpio_write_port(HX8346_PORT_DB_L, (UINT8)hx8346_fill_color);
		gpio_clear_pin(HX8346_PORT_WR, HX8346_PIN_WR);
		gpio_set_pin(HX8346_PORT_WR, HX8346_PIN_WR);
	}
	hx8346_cs_release();
}

UINT16 hx8346_draw_text(UINT16 row, UINT16 col, const char* str)
{
	UINT16 str_base;
	UINT16 font_idx;
	UINT8 font_byte;
	UINT8 font_line;
	UINT8 font_col;	
	
	str_base = (UINT16)str;
	while((col <= (HX8346_DA_COL_END - 8)) && *str)
	{
		if(*str == '\n')
		{
			++str;
			row += 8;
			continue;
		}
		font_idx = (*str++) << 3;
		
		hx8346_set_gram_window(row, col, 8, 8);
		col += 8;
		
		hx8346_cs_assert();
		for(font_line = 0; font_line < 8; ++font_line)
		{
			font_byte = hx8346_8x8_font[font_idx++];
			for(font_col = 0; font_col < 8; ++font_col)
			{
				if(font_byte & 0x80)
				{
					gpio_write_port(HX8346_PORT_DB_H, (UINT8)(hx8346_text_fg_color >> 8));
					gpio_write_port(HX8346_PORT_DB_L, (UINT8)hx8346_text_fg_color);
					gpio_clear_pin(HX8346_PORT_WR, HX8346_PIN_WR);
					gpio_set_pin(HX8346_PORT_WR, HX8346_PIN_WR);
				}
				else
				{
					gpio_write_port(HX8346_PORT_DB_H, (UINT8)(hx8346_text_bg_color >> 8));
					gpio_write_port(HX8346_PORT_DB_L, (UINT8)hx8346_text_bg_color);
					gpio_clear_pin(HX8346_PORT_WR, HX8346_PIN_WR);
					gpio_set_pin(HX8346_PORT_WR, HX8346_PIN_WR);
				}
				font_byte = font_byte << 1;
			}
		}
		hx8346_cs_release();
	}
	return (UINT16)str - str_base;
}

void hx8346_draw_bitmap(UINT16* bitmap, UINT16 row, UINT16 col, UINT16 width, UINT16 height)
{
	UINT16 num_pixels;
	
	num_pixels = width * height;
	hx8346_set_gram_window(row, col, width, height);
	hx8346_write_data(bitmap, num_pixels);
}

