#define NO_XSFR_DEFINE
#include "CH559.H"
#include "CH559_I2C.h"
#include "CH559_SSD1306.h"

UINT8 ssd1306_frame_buf[SSD1306_BUF_SIZE];

UINT8 code ssd1306_8x8_font[1024] = {
	0x00, 0x00, 0x00, 0x00, 0x00, 0x00, 0x00, 0x00, 0x00, 0x00, 0x00, 0x00,
	0x00, 0x00, 0x00, 0x00, 0x00, 0x00, 0x00, 0x00, 0x00, 0x00, 0x00, 0x00,
	0x00, 0x00, 0x00, 0x00, 0x00, 0x00, 0x00, 0x00, 0x00, 0x00, 0x00, 0x00,
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	0x00, 0x00, 0x00, 0x00
};

void ssd1306_init(UINT8 sda_port_sel, UINT8 sda_pin_sel, UINT8 scl_port_sel, UINT8 scl_pin_sel)
{	
	i2c_init(sda_port_sel, sda_pin_sel, scl_port_sel, scl_pin_sel);
	ssd1306_command_1_byte(SSD1306_COM_DISPLAY_OFF);
	ssd1306_command_2_byte(SSD1306_COM_SET_OSC_FREQ, SSD1306_DEF_OSC_FREQ_DIV);
	ssd1306_command_2_byte(SSD1306_COM_SET_MUX_RATIO, SSD1306_DEF_MUX_RATIO);
	ssd1306_command_2_byte(SSD1306_COM_SET_OFFSET, SSD1306_DEF_DISPLAY_OFFSET);
	ssd1306_command_1_byte(SSD1306_COM_SET_START_LINE | SSD1306_DEF_START_LINE);
	ssd1306_command_2_byte(SSD1306_COM_SET_ADDR_MODE, SSD1306_DEF_ADDR_MODE);
	ssd1306_command_1_byte(SSD1306_COM_SEGMENT_REMAP | SSD1306_DEF_SEGMENT_REMAP);
	ssd1306_command_1_byte(SSD1306_COM_SCAN_DIRECTION | SSD1306_DEF_SCAN_DIRECTION);
	ssd1306_command_2_byte(SSD1306_COM_PINS_CONFIG, SSD1306_DEF_PINS_CONFIG);
	ssd1306_command_2_byte(SSD1306_COM_SET_CONTRAST, SSD1306_DEF_SET_CONTRAST);
	ssd1306_command_2_byte(SSD1306_COM_SET_PERIOD, SSD1306_DEF_PRE_PERIOD);
	ssd1306_command_1_byte(SSD1306_COM_ENTIRE_DISP_ON);
	ssd1306_command_1_byte(SSD1306_COM_SET_NORMAL_DISP);
	ssd1306_command_2_byte(SSD1306_COM_SET_CHARGE_PUMP, 0x14);
	ssd1306_command_1_byte(SSD1306_COM_DISPLAY_ON);
	ssd1306_clear_display(0x00);
	ssd1306_update_display();	//update_display sets the page and column address
}

void ssd1306_command_1_byte(UINT8 command)
{
	i2c_start();
	i2c_write(SSD1306_BUS_ADDR);
	i2c_write(SSD1306_CB_COMMAND);
	i2c_write(command);
	i2c_stop();
}

void ssd1306_command_2_byte(UINT8 command, UINT8 arg)
{
	i2c_start();
	i2c_write(SSD1306_BUS_ADDR);
	i2c_write(SSD1306_CB_COMMAND);
	i2c_write(command);
	i2c_write(arg);
	i2c_stop();
}

void ssd1306_command_3_byte(UINT8 command, UINT8 arg1, UINT8 arg2)
{
	i2c_start();
	i2c_write(SSD1306_BUS_ADDR);
	i2c_write(SSD1306_CB_COMMAND);
	i2c_write(command);
	i2c_write(arg1);
	i2c_write(arg2);
	i2c_stop();
}

void ssd1306_set_pixel(UINT8 row, UINT8 col, UINT8 state)
{
	UINT8 mask;
	UINT8 page;
	UINT16 idx;
	
	mask = 0x01 << (row & 0x07);
	page = row >> 3;
	idx = page * SSD1306_NUM_COLUMNS + col;
	if(state)
		ssd1306_frame_buf[idx] |= mask;
	else
		ssd1306_frame_buf[idx] &= ~mask;
}

//HINT: Text must be aligned to 8-pixel text lines, but can start on any column.
void ssd1306_draw_text(UINT8 line, UINT8 col, char* str)
{
	UINT8 font_line;
	UINT16 buf_idx;
	UINT16 font_idx;
	
	buf_idx = line * SSD1306_NUM_COLUMNS + col;
	while((buf_idx < SSD1306_BUF_SIZE) && *str)
	{
		if(*str == '\n')
		{
			line += 1;
			buf_idx = line * SSD1306_NUM_COLUMNS;
		}
		else
		{
			font_idx = (*str) << 3;
			for(font_line = 0; font_line < 8; ++font_line)
			{
				ssd1306_frame_buf[buf_idx++] = ssd1306_8x8_font[font_idx++];
			}
			col += 8;
		}
		
		++str;
	}
}

//HINT: scrolls up by 8-pixel lines. It does not matter if the display contains text or graphics.
void ssd1306_scroll_text_up(UINT8 num_lines)
{
	UINT16 read_idx;
	UINT16 write_idx;
	
	read_idx = num_lines * SSD1306_NUM_COLUMNS;
	write_idx = 0;
	while(read_idx < SSD1306_BUF_SIZE)
	{
		ssd1306_frame_buf[write_idx] = ssd1306_frame_buf[read_idx];
		read_idx += 1;
		write_idx += 1;
	}
}

void ssd1306_clear_display(UINT8 fill)
{
	UINT16 idx;
	
	for(idx = 0; idx < SSD1306_BUF_SIZE; ++idx)
	{
		ssd1306_frame_buf[idx] = fill;
	}
}

void ssd1306_clear_page(UINT8 page, UINT8 fill)
{
	UINT8 count;
	UINT16 buf_idx;
	
	buf_idx = page * SSD1306_NUM_COLUMNS;
	for(count = 0; count < SSD1306_NUM_COLUMNS; ++count)
	{
		ssd1306_frame_buf[buf_idx++] = fill;
	}
}

void ssd1306_update_display(void)
{
	UINT16 idx;
	
	ssd1306_command_3_byte(SSD1306_COM_SET_COLUMN_ADDR, SSD1306_DEF_COL_START_ADDR, SSD1306_DEF_COL_END_ADDR);
	ssd1306_command_3_byte(SSD1306_COM_SET_PAGE_ADDR, SSD1306_DEF_PAGE_START_ADDR, SSD1306_DEF_PAGE_END_ADDR);
	
	i2c_start();
	i2c_write(SSD1306_BUS_ADDR);
	i2c_write(SSD1306_CB_DATA);
	for(idx = 0; idx < SSD1306_BUF_SIZE; ++idx)
	{
		i2c_write(ssd1306_frame_buf[idx]);
	}
	i2c_stop();
}

void ssd1306_update_page(UINT8 page)
{
	UINT8 count;
	UINT16 buf_idx;
	
	buf_idx = page * SSD1306_NUM_COLUMNS;
	
	ssd1306_command_3_byte(SSD1306_COM_SET_COLUMN_ADDR, SSD1306_DEF_COL_START_ADDR, SSD1306_DEF_COL_END_ADDR);
	ssd1306_command_3_byte(SSD1306_COM_SET_PAGE_ADDR, page, SSD1306_DEF_PAGE_END_ADDR);
	
	i2c_start();
	i2c_write(SSD1306_BUS_ADDR);
	i2c_write(SSD1306_CB_DATA);
	for(count = 0; count < SSD1306_NUM_COLUMNS; ++count)
	{
		i2c_write(ssd1306_frame_buf[buf_idx++]);
	}
	i2c_stop();
}
