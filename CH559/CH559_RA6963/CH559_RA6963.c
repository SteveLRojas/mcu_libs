#define NO_XSFR_DEFINE
#include "CH559.H"
#include "CH559_GPIO.h"
#include "CH559_RCC.h"
#include "CH559_RA6963.h"

UINT8 ra6963_status_mask;
UINT8 ra6963_frame_buf[RA6963_BUF_SIZE];

UINT8 code ra6963_8x8_font[1024] = {
	0x00, 0x00, 0x00, 0x00, 0x00, 0x00, 0x00, 0x00, 0x00, 0x00, 0x00, 0x00,
	0x00, 0x00, 0x00, 0x00, 0x00, 0x00, 0x00, 0x00, 0x00, 0x00, 0x00, 0x00,
	0x00, 0x00, 0x00, 0x00, 0x00, 0x00, 0x00, 0x00, 0x00, 0x00, 0x00, 0x00,
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	0x00, 0x00, 0x00, 0x00
};

void ra6963_init(void)
{
	ra6963_status_mask = 0x03;
	gpio_set_port_mode(RA6963_PORT_SD, GPIO_PORT_MODE_PP);
	gpio_set_pin_mode(GPIO_MODE_INPUT, RA6963_PORT_SD, GPIO_PIN_7 | GPIO_PIN_6 | GPIO_PIN_5 | GPIO_PIN_4 | GPIO_PIN_3 | GPIO_PIN_2 | GPIO_PIN_1 | GPIO_PIN_0);
	
	ra6963_send_data(0x00);
	ra6963_send_data(0x00);
	ra6963_send_command(RA6963_COM_SET_GRAPHIC_HOME_ADDR);
	
	ra6963_send_data(RA6963_ROW_SIZE);
	ra6963_send_data(0x00);
	ra6963_send_command(RA6963_COM_SET_GRAPHIC_AREA);
	
	ra6963_send_command(RA6963_COM_SET_DISPLAY_MODE | RA6963_DISPLAY_MODE_GRAPHIC_ON);
	
	ra6963_clear_display(0x00);
	ra6963_update_display();
}

void ra6963_send_command(UINT8 command)
{
	UINT8 status = 0;
	
	gpio_set_pin_mode(GPIO_MODE_INPUT, RA6963_PORT_SD, GPIO_PIN_7 | GPIO_PIN_6 | GPIO_PIN_5 | GPIO_PIN_4 | GPIO_PIN_3 | GPIO_PIN_2 | GPIO_PIN_1 | GPIO_PIN_0);
	gpio_set_pin(RA6963_PORT_CD, RA6963_PIN_CD);
	gpio_set_pin(RA6963_PORT_WR, RA6963_PIN_WR);
	gpio_clear_pin(RA6963_PORT_CE, RA6963_PIN_CE);
	do
	{
		gpio_clear_pin(RA6963_PORT_RD, RA6963_PIN_RD);
		status = gpio_read_port(RA6963_PORT_SD);
		gpio_set_pin(RA6963_PORT_RD, RA6963_PIN_RD);
	} while((status & ra6963_status_mask) != ra6963_status_mask);
	
	gpio_set_pin_mode(GPIO_MODE_OUTPUT_PP, RA6963_PORT_SD, GPIO_PIN_7 | GPIO_PIN_6 | GPIO_PIN_5 | GPIO_PIN_4 | GPIO_PIN_3 | GPIO_PIN_2 | GPIO_PIN_1 | GPIO_PIN_0);
	gpio_write_port(RA6963_PORT_SD, command);
	gpio_clear_pin(RA6963_PORT_WR, RA6963_PIN_WR);
	gpio_set_pin(RA6963_PORT_WR, RA6963_PIN_WR);
	gpio_set_pin(RA6963_PORT_CE, RA6963_PIN_CE);
}

void ra6963_send_data(UINT8 val)
{
	UINT8 status = 0;
	
	gpio_set_pin_mode(GPIO_MODE_INPUT, RA6963_PORT_SD, GPIO_PIN_7 | GPIO_PIN_6 | GPIO_PIN_5 | GPIO_PIN_4 | GPIO_PIN_3 | GPIO_PIN_2 | GPIO_PIN_1 | GPIO_PIN_0);
	gpio_set_pin(RA6963_PORT_CD, RA6963_PIN_CD);
	gpio_set_pin(RA6963_PORT_WR, RA6963_PIN_WR);
	gpio_clear_pin(RA6963_PORT_CE, RA6963_PIN_CE);
	do
	{
		gpio_clear_pin(RA6963_PORT_RD, RA6963_PIN_RD);
		status = gpio_read_port(RA6963_PORT_SD);
		gpio_set_pin(RA6963_PORT_RD, RA6963_PIN_RD);
	} while((status & ra6963_status_mask) != ra6963_status_mask);
	
	gpio_set_pin_mode(GPIO_MODE_OUTPUT_PP, RA6963_PORT_SD, GPIO_PIN_7 | GPIO_PIN_6 | GPIO_PIN_5 | GPIO_PIN_4 | GPIO_PIN_3 | GPIO_PIN_2 | GPIO_PIN_1 | GPIO_PIN_0);
	gpio_clear_pin(RA6963_PORT_CD, RA6963_PIN_CD);
	gpio_write_port(RA6963_PORT_SD, val);
	gpio_clear_pin(RA6963_PORT_WR, RA6963_PIN_WR);
	gpio_set_pin(RA6963_PORT_WR, RA6963_PIN_WR);
	gpio_set_pin(RA6963_PORT_CE, RA6963_PIN_CE);
}

void ra6963_set_pixel(UINT8 row, UINT8 col, UINT8 state)
{
	UINT8 mask;
	UINT16 idx;
	
	mask = 0x80 >> (col & 0x07);
	idx = row * RA6963_ROW_SIZE + (col >> 3);
	if(state)
		ra6963_frame_buf[idx] |= mask;
	else
		ra6963_frame_buf[idx] &= ~mask;
}

//HINT: Text must be aligned to 8-pixel text columns, but can start on any row.
void ra6963_draw_text(UINT8 row, UINT8 text_col, char* str)
{
	UINT8 font_line;
	UINT16 buf_idx;
	UINT16 font_idx;
	
	buf_idx = row * RA6963_ROW_SIZE + text_col;
	while((buf_idx < (RA6963_BUF_SIZE - 7 * RA6963_ROW_SIZE)) && *str)
	{
		if(*str == '\n')
		{
			row += 8;
			buf_idx = row * RA6963_ROW_SIZE;
		}
		else
		{
			font_idx = (*str) << 3;
			for(font_line = 0; font_line < 8; ++font_line)
			{
				ra6963_frame_buf[buf_idx] = ra6963_8x8_font[font_idx++];
				buf_idx += RA6963_ROW_SIZE;
			}
			buf_idx -= 8 * RA6963_ROW_SIZE - 1;
		}

		++str;
	}
}

void ra6963_scroll_up(UINT8 num_rows)
{
	UINT16 read_idx;
	UINT16 write_idx;
	
	read_idx = num_rows * RA6963_ROW_SIZE;
	write_idx = 0;
	while(read_idx < RA6963_BUF_SIZE)
	{
		ra6963_frame_buf[write_idx] = ra6963_frame_buf[read_idx];
		read_idx += 1;
		write_idx += 1;
	}
}

void ra6963_clear_display(UINT8 fill)
{
	UINT16 idx;
	
	for(idx = 0; idx < RA6963_BUF_SIZE; ++idx)
	{
		ra6963_frame_buf[idx] = fill;
	}
}

void ra6963_clear_rows(UINT8 start, UINT8 end, UINT8 fill)
{
	UINT16 buf_idx;
	
	for(buf_idx = start * RA6963_ROW_SIZE; buf_idx < end * RA6963_ROW_SIZE; ++buf_idx)
	{
		ra6963_frame_buf[buf_idx] = fill;
	}
}

void ra6963_update_rows(UINT8 start, UINT8 end)
{
	UINT16 idx;
	UINT16 stop;

	idx  = (UINT16)start * RA6963_ROW_SIZE;
	stop = (UINT16)end * RA6963_ROW_SIZE;

	ra6963_status_mask = 0x03;
	ra6963_send_data((UINT8)idx);
	ra6963_send_data((UINT8)(idx >> 8));
	ra6963_send_command(RA6963_COM_SET_ADDRESS_POINTER);

	ra6963_send_command(RA6963_COM_DATA_AUTO_WRITE);
	ra6963_status_mask = 0x08;
	while(idx < stop)
	{
		ra6963_send_data(ra6963_frame_buf[idx++]);
	}
	ra6963_send_command(RA6963_COM_AUTO_RESET);
}
