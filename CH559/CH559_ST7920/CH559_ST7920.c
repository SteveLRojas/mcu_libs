#define NO_XSFR_DEFINE
#include "CH559.H"
#include "CH559_GPIO.h"
#include "CH559_RCC.h"
#include "CH559_SPI.h"
#include "CH559_ST7920.h"

UINT8 st7920_frame_buf[ST7920_BUF_SIZE];

UINT8 st7920_8x8_font[1024] = {
	0x00, 0x00, 0x00, 0x00, 0x00, 0x00, 0x00, 0x00, 0x00, 0x00, 0x00, 0x00,
	0x00, 0x00, 0x00, 0x00, 0x00, 0x00, 0x00, 0x00, 0x00, 0x00, 0x00, 0x00,
	0x00, 0x00, 0x00, 0x00, 0x00, 0x00, 0x00, 0x00, 0x00, 0x00, 0x00, 0x00,
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	0x00, 0x00, 0x00, 0x00
};

void st7920_init(void)
{
	gpio_clear_pin(ST7920_PORT_CS, ST7920_PIN_CS);
	spi_init(ST7920_SPI_MODULE, ST7920_SPI_CLK_DIV, SPI_MODE_3);

	st7920_send_command(ST7920_COM_FUNCTION_SET | ST7920_FUNCTION_SET_8_BIT);
	rcc_delay_us(ST7920_FN_SET_INIT0_TIM);
	st7920_send_command(ST7920_COM_FUNCTION_SET | ST7920_FUNCTION_SET_8_BIT);
	rcc_delay_us(ST7920_FN_SET_INIT1_TIM);
	st7920_send_command(ST7920_COM_DISP_ON_OFF | ST7920_DISP_ON_OFF_DISP_ON);
	rcc_delay_us(ST7920_DEFAULT_CMD_TIM);
	st7920_send_command(ST7920_COM_FUNCTION_SET | ST7920_FUNCTION_SET_8_BIT | ST7920_FUNCTION_SET_EXT);
	rcc_delay_us(ST7920_DEFAULT_CMD_TIM);
	st7920_send_command(ST7920_COM_FUNCTION_SET | ST7920_FUNCTION_SET_8_BIT | ST7920_FUNCTION_SET_EXT | ST7920_FUNCTION_SET_GRAPHIC);
	rcc_delay_us(ST7920_DEFAULT_CMD_TIM);

	st7920_clear_display(0x00);
	st7920_update_display();
}

void st7920_send_command(UINT8 command)
{
	gpio_set_pin(ST7920_PORT_CS, ST7920_PIN_CS);
	spi_transfer(ST7920_SPI_MODULE, 0xF8);
	spi_transfer(ST7920_SPI_MODULE, command & 0xF0);
	spi_transfer(ST7920_SPI_MODULE, command << 4);
	gpio_clear_pin(ST7920_PORT_CS, ST7920_PIN_CS);
}

void st7920_send_data(UINT8 val)
{
	gpio_set_pin(ST7920_PORT_CS, ST7920_PIN_CS);
	spi_transfer(ST7920_SPI_MODULE, 0xFA);
	spi_transfer(ST7920_SPI_MODULE, val & 0xF0);
	spi_transfer(ST7920_SPI_MODULE, val << 4);
	gpio_clear_pin(ST7920_PORT_CS, ST7920_PIN_CS);
}

void st7920_set_pixel(UINT8 row, UINT8 col, UINT8 state)
{
	UINT8 mask;
	UINT16 idx;
	
	mask = 0x80 >> (col & 0x07);
	idx = row * ST7920_ROW_SIZE + (col >> 3);
	if(state)
		st7920_frame_buf[idx] |= mask;
	else
		st7920_frame_buf[idx] &= ~mask;
}

//HINT: Text must be aligned to 8-pixel text columns, but can start on any row.
void st7920_draw_text(UINT8 row, UINT8 text_col, char* str)
{
	UINT8 font_line;
	UINT16 buf_idx;
	UINT16 font_idx;
	
	buf_idx = row * ST7920_ROW_SIZE + text_col;
	while((buf_idx < (ST7920_BUF_SIZE - 7 * ST7920_ROW_SIZE)) && *str)
	{
		if(*str == '\n')
		{
			row += 8;
			buf_idx = row * ST7920_ROW_SIZE;
		}
		else
		{
			font_idx = (*str) << 3;
			for(font_line = 0; font_line < 8; ++font_line)
			{
				st7920_frame_buf[buf_idx] = st7920_8x8_font[font_idx++];
				buf_idx += ST7920_ROW_SIZE;
			}
			buf_idx -= 8 * ST7920_ROW_SIZE - 1;
		}

		++str;
	}
}

void st7920_scroll_up(UINT8 num_rows)
{
	UINT16 read_idx;
	UINT16 write_idx;
	
	read_idx = num_rows * ST7920_ROW_SIZE;
	write_idx = 0;
	while(read_idx < ST7920_BUF_SIZE)
	{
		st7920_frame_buf[write_idx] = st7920_frame_buf[read_idx];
		read_idx += 1;
		write_idx += 1;
	}
}

void st7920_clear_display(UINT8 fill)
{
	UINT16 idx;
	
	for(idx = 0; idx < ST7920_BUF_SIZE; ++idx)
	{
		st7920_frame_buf[idx] = fill;
	}
}

void st7920_clear_rows(UINT8 start, UINT8 end, UINT8 fill)
{
	UINT16 buf_idx;
	
	for(buf_idx = start * ST7920_ROW_SIZE; buf_idx < end * ST7920_ROW_SIZE; ++buf_idx)
	{
		st7920_frame_buf[buf_idx] = fill;
	}
}

void st7920_update_rows(UINT8 start, UINT8 end)
{
	UINT8 row;
	UINT8 col;
	UINT16 buf_idx;

	buf_idx = start * ST7920_ROW_SIZE;
	for(row = start; row < end; ++row)
	{
		st7920_send_command(ST7920_EXT_COM_GDRAM_ADDR | (row & 0x1F));
		rcc_delay_us(ST7920_DEFAULT_CMD_TIM);

		st7920_send_command(ST7920_EXT_COM_GDRAM_ADDR | ((row & 0xE0) >> 2));
		rcc_delay_us(ST7920_DEFAULT_CMD_TIM);

		for(col = 0; col < ST7920_ROW_SIZE; ++col)
		{
			st7920_send_data(st7920_frame_buf[buf_idx++]);
			rcc_delay_us(ST7920_DEFAULT_CMD_TIM);
		}
	}
}
