#define NO_XSFR_DEFINE
#include "CH559.H"
#include "CH559_GPIO.h"
#include "CH559_SPI.h"
#include "CH559_PCD8544.h"

UINT8 pcd8544_frame_buf[PCD8544_BUF_SIZE];

UINT8 code pcd8544_8x8_font[1024] = {
	0x00, 0x00, 0x00, 0x00, 0x00, 0x00, 0x00, 0x00, 0x00, 0x00, 0x00, 0x00,
	0x00, 0x00, 0x00, 0x00, 0x00, 0x00, 0x00, 0x00, 0x00, 0x00, 0x00, 0x00,
	0x00, 0x00, 0x00, 0x00, 0x00, 0x00, 0x00, 0x00, 0x00, 0x00, 0x00, 0x00,
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	0x00, 0x00, 0x00, 0x00
};

void pcd8544_init(void)
{
	gpio_clear_pin(PCD8544_PORT_RST, PCD8544_PIN_RST);
	gpio_set_pin(PCD8544_PORT_RST, PCD8544_PIN_RST);
	gpio_set_pin(PCD8544_PORT_CE, PCD8544_PIN_CE);
	spi_init(PCD8544_SPI_MODULE, PCD8544_SPI_CLK_DIV, SPI_MODE_3);
	
	pcd8544_send_command(PCD8544_COM_EXT_ISTR);
	pcd8544_send_command(PCD8544_COM_SET_BIAS | PCD8544_DEF_BIAS);
	pcd8544_send_command(PCD8544_COM_SET_VOP | PCD8544_DEF_CONTRAST);
	pcd8544_send_command(PCD8544_COM_SET_T_COEF | PCD8544_DEF_T_COEF);
	pcd8544_send_command(PCD8544_COM_BAS_ISTR);
	pcd8544_send_command(PCD8544_COM_SET_NORMAL);
	
	pcd8544_clear_display(0x00);
	pcd8544_update_display();	//update_display sets the page and column address
}

void pcd8544_send_command(UINT8 command)
{
	gpio_clear_pin(PCD8544_PORT_DC, PCD8544_PIN_DC);
	gpio_clear_pin(PCD8544_PORT_CE, PCD8544_PIN_CE);
	spi_transfer(PCD8544_SPI_MODULE, command);
	gpio_set_pin(PCD8544_PORT_CE, PCD8544_PIN_CE);
}

void pcd8544_send_data(UINT8 val)
{
	gpio_set_pin(PCD8544_PORT_DC, PCD8544_PIN_DC);
	gpio_clear_pin(PCD8544_PORT_CE, PCD8544_PIN_CE);
	spi_transfer(PCD8544_SPI_MODULE, val);
	gpio_set_pin(PCD8544_PORT_CE, PCD8544_PIN_CE);
}

void pcd8544_set_pixel(UINT8 row, UINT8 col, UINT8 state)
{
	UINT8 mask;
	UINT8 page;
	UINT16 idx;
	
	mask = 0x01 << (row & 0x07);
	page = row >> 3;
	idx = page * PCD8544_NUM_COLUMNS + col;
	if(state)
		pcd8544_frame_buf[idx] |= mask;
	else
		pcd8544_frame_buf[idx] &= ~mask;
}

//HINT: Text must be aligned to 8-pixel text lines, but can start on any column.
void pcd8544_draw_text(UINT8 line, UINT8 col, char* str)
{
	UINT8 font_line;
	UINT16 buf_idx;
	UINT16 font_idx;
	
	buf_idx = line * PCD8544_NUM_COLUMNS + col;
	while((buf_idx < PCD8544_BUF_SIZE) && *str)
	{
		if(*str == '\n')
		{
			line += 1;
			buf_idx = line * PCD8544_NUM_COLUMNS;
		}
		else
		{
			font_idx = (*str) << 3;
			for(font_line = 0; font_line < 8; ++font_line)
			{
				pcd8544_frame_buf[buf_idx++] = pcd8544_8x8_font[font_idx++];
			}
		}
		
		++str;
	}
}

//HINT: scrolls up by 8-pixel lines. It does not matter if the display contains text or graphics.
void pcd8544_scroll_text_up(UINT8 num_lines)
{
	UINT16 read_idx;
	UINT16 write_idx;
	
	read_idx = num_lines * PCD8544_NUM_COLUMNS;
	write_idx = 0;
	while(read_idx < PCD8544_BUF_SIZE)
	{
		pcd8544_frame_buf[write_idx] = pcd8544_frame_buf[read_idx];
		read_idx += 1;
		write_idx += 1;
	}
}

void pcd8544_clear_display(UINT8 fill)
{
	UINT16 idx;
	
	for(idx = 0; idx < PCD8544_BUF_SIZE; ++idx)
	{
		pcd8544_frame_buf[idx] = fill;
	}
}

void pcd8544_clear_page(UINT8 page, UINT8 fill)
{
	UINT8 count;
	UINT16 buf_idx;
	
	buf_idx = page * PCD8544_NUM_COLUMNS;
	for(count = 0; count < PCD8544_NUM_COLUMNS; ++count)
	{
		pcd8544_frame_buf[buf_idx++] = fill;
	}
}

void pcd8544_update_display(void)
{
	UINT16 idx;
	
	pcd8544_send_command(PCD8544_COM_SET_COLUMN | PCD8544_DEF_COL_START);
	pcd8544_send_command(PCD8544_COM_SET_PAGE | PCD8544_DEF_PAGE_START);
	
	gpio_set_pin(PCD8544_PORT_DC, PCD8544_PIN_DC);
	gpio_clear_pin(PCD8544_PORT_CE, PCD8544_PIN_CE);
	for(idx = 0; idx < PCD8544_BUF_SIZE; ++idx)
	{
		spi_transfer(PCD8544_SPI_MODULE, pcd8544_frame_buf[idx]);
	}
	gpio_set_pin(PCD8544_PORT_CE, PCD8544_PIN_CE);
}

void pcd8544_update_page(UINT8 page)
{
	UINT8 count;
	UINT16 buf_idx;
	
	buf_idx = page * PCD8544_NUM_COLUMNS;
	
	pcd8544_send_command(PCD8544_COM_SET_COLUMN | PCD8544_DEF_COL_START);
	pcd8544_send_command(PCD8544_COM_SET_PAGE | page);
	
	gpio_set_pin(PCD8544_PORT_DC, PCD8544_PIN_DC);
	gpio_clear_pin(PCD8544_PORT_CE, PCD8544_PIN_CE);
	for(count = 0; count < PCD8544_NUM_COLUMNS; ++count)
	{
		spi_transfer(PCD8544_SPI_MODULE, pcd8544_frame_buf[buf_idx++]);
	}
	gpio_set_pin(PCD8544_PORT_CE, PCD8544_PIN_CE);
}
