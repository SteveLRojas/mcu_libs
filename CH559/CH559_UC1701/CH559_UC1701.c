#define NO_XSFR_DEFINE
#include "CH559.H"
#include "CH559_GPIO.h"
#include "CH559_RCC.h"
#include "CH559_SPI.h"
#include "CH559_UC1701.h"

UINT8 uc1701_frame_buf[UC1701_BUF_SIZE];

UINT8 code uc1701_8x8_font[1024] = {
	0x00, 0x00, 0x00, 0x00, 0x00, 0x00, 0x00, 0x00, 0x00, 0x00, 0x00, 0x00,
	0x00, 0x00, 0x00, 0x00, 0x00, 0x00, 0x00, 0x00, 0x00, 0x00, 0x00, 0x00,
	0x00, 0x00, 0x00, 0x00, 0x00, 0x00, 0x00, 0x00, 0x00, 0x00, 0x00, 0x00,
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	0x00, 0x00, 0x00, 0x00
};

void uc1701_init(void)
{
	spi_init(UC1701_SPI_MODULE, UC1701_SPI_CLK_DIV, SPI_MODE_3);
	gpio_set_pin(UC1701_PORT_CS, UC1701_PIN_CS);
	gpio_clear_pin(UC1701_PORT_RST, UC1701_PIN_RST);
	gpio_set_pin(UC1701_PORT_RST, UC1701_PIN_RST);
	rcc_delay_ms(6);
	
	uc1701_send_command(UC1701_COM_SET_SCROLL_LINE | 0x00);
	uc1701_send_command(UC1701_COM_SET_SEG_DIR | UC1701_SEG_DIR_FORWARD);
	uc1701_send_command(UC1701_COM_SET_COM_DIR | UC1701_COM_DIR_REVERSE);
	uc1701_send_command(UC1701_COM_SET_BIAS_RATIO | UC1701_BIAS_RATIO_LOW);
	uc1701_send_command(UC1701_COM_SET_POWER_CTRL | UC1701_POWER_CTRL_BOOST | UC1701_POWER_CTRL_VREG | UC1701_POWER_CTRL_VFOLLOW);
	uc1701_send_command_2b(UC1701_COM_SET_BOOST_RATIO, 0x00);
	//uc1701_send_command(UC1701_COM_SET_BOOST_RATIO);
	//uc1701_send_command(0x00);
	uc1701_send_command(UC1701_COM_SET_RES_RATIO | 0x04);
	uc1701_send_command_2b(UC1701_COM_SET_ELEC_VOL, 0x30);
	//uc1701_send_command(UC1701_COM_SET_ELEC_VOL);
	//uc1701_send_command(0x28);
	uc1701_send_command(UC1701_COM_SET_ALL_PIX_ON | UC1701_ALL_PIX_OFF);
	uc1701_send_command(UC1701_COM_SET_INVERT_DISP | UC1701_INVERT_DISP_OFF);
	uc1701_send_command(UC1701_COM_SET_DISP_ENABLE | UC1701_DISP_ENABLE_ON);
	
	uc1701_clear_display(0x00);
	uc1701_update_display();
}

void uc1701_send_command(UINT8 command)
{
	gpio_clear_pin(UC1701_PORT_CD, UC1701_PIN_CD);
	gpio_clear_pin(UC1701_PORT_CS, UC1701_PIN_CS);
    spi_transfer(UC1701_SPI_MODULE, command);
	gpio_set_pin(UC1701_PORT_CS, UC1701_PIN_CS);
}

void uc1701_send_command_2b(UINT8 command1, UINT8 command2)
{
	gpio_clear_pin(UC1701_PORT_CD, UC1701_PIN_CD);
	gpio_clear_pin(UC1701_PORT_CS, UC1701_PIN_CS);
    spi_transfer(UC1701_SPI_MODULE, command1);
	spi_transfer(UC1701_SPI_MODULE, command2);
	gpio_set_pin(UC1701_PORT_CS, UC1701_PIN_CS);
}

void uc1701_send_data(UINT8 val)
{
	gpio_set_pin(UC1701_PORT_CD, UC1701_PIN_CD);
	gpio_clear_pin(UC1701_PORT_CS, UC1701_PIN_CS);
    spi_transfer(UC1701_SPI_MODULE, val);
	gpio_set_pin(UC1701_PORT_CS, UC1701_PIN_CS);
}

void uc1701_set_pixel(UINT8 row, UINT8 col, UINT8 state)
{
	UINT8 mask;
	UINT8 page;
	UINT16 idx;
	
	mask = 0x01 << (row & 0x07);
	page = row >> 3;
	idx = page * UC1701_NUM_COLUMNS + col;
	if(state)
		uc1701_frame_buf[idx] |= mask;
	else
		uc1701_frame_buf[idx] &= ~mask;
}

//HINT: Text must be aligned to 8-pixel text lines, but can start on any column.
void uc1701_draw_text(UINT8 line, UINT8 col, char* str)
{
	UINT8 font_line;
	UINT16 buf_idx;
	UINT16 font_idx;
	
	buf_idx = line * UC1701_NUM_COLUMNS + col;
	while((buf_idx < UC1701_BUF_SIZE) && *str)
	{
		if(*str == '\n')
		{
			line += 1;
			buf_idx = line * UC1701_NUM_COLUMNS;
		}
		else
		{
			font_idx = (*str) << 3;
			for(font_line = 0; font_line < 8; ++font_line)
			{
				uc1701_frame_buf[buf_idx++] = uc1701_8x8_font[font_idx++];
			}
		}
		
		++str;
	}
}

//HINT: scrolls up by 8-pixel lines. It does not matter if the display contains text or graphics.
void uc1701_scroll_text_up(UINT8 num_lines)
{
	UINT16 read_idx;
	UINT16 write_idx;
	
	read_idx = num_lines * UC1701_NUM_COLUMNS;
	write_idx = 0;
	while(read_idx < UC1701_BUF_SIZE)
	{
		uc1701_frame_buf[write_idx] = uc1701_frame_buf[read_idx];
		read_idx += 1;
		write_idx += 1;
	}
}

void uc1701_clear_display(UINT8 fill)
{
	UINT16 idx;
	
	for(idx = 0; idx < UC1701_BUF_SIZE; ++idx)
	{
		uc1701_frame_buf[idx] = fill;
	}
}

void uc1701_clear_page(UINT8 page, UINT8 fill)
{
	UINT8 count;
	UINT16 buf_idx;
	
	buf_idx = page * UC1701_NUM_COLUMNS;
	for(count = 0; count < UC1701_NUM_COLUMNS; ++count)
	{
		uc1701_frame_buf[buf_idx++] = fill;
	}
}

void uc1701_update_display(void)
{
	UINT8 page;
	UINT16 idx = 0;
	
	for(page = 0; page < UC1701_NUM_PAGES; ++page)
	{
		uc1701_send_command(UC1701_COM_SET_PAGE_ADDR | page);
		uc1701_send_command(UC1701_COM_SET_COL_ADDR_L | 0x00);
		uc1701_send_command(UC1701_COM_SET_COL_ADDR_H | 0x00);
		
		gpio_set_pin(UC1701_PORT_CD, UC1701_PIN_CD);
		gpio_clear_pin(UC1701_PORT_CS, UC1701_PIN_CS);
		spi_bulk_out(UC1701_SPI_MODULE, uc1701_frame_buf + idx, UC1701_NUM_COLUMNS);
		gpio_set_pin(UC1701_PORT_CS, UC1701_PIN_CS);
		idx += UC1701_NUM_COLUMNS;
	}
}

void uc1701_update_page(UINT8 page)
{
	UINT16 buf_idx;
	
	buf_idx = page * UC1701_NUM_COLUMNS;
	
	uc1701_send_command(UC1701_COM_SET_PAGE_ADDR | page);
	uc1701_send_command(UC1701_COM_SET_COL_ADDR_L | 0x00);
	uc1701_send_command(UC1701_COM_SET_COL_ADDR_H | 0x00);
	
	gpio_set_pin(UC1701_PORT_CD, UC1701_PIN_CD);
	gpio_clear_pin(UC1701_PORT_CS, UC1701_PIN_CS);
	spi_bulk_out(UC1701_SPI_MODULE, uc1701_frame_buf + buf_idx, UC1701_NUM_COLUMNS);
	gpio_set_pin(UC1701_PORT_CS, UC1701_PIN_CS);
}
